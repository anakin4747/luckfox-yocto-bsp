## layers/meta-luckfox-bsp/conf/layer.conf
```bitbake
# meta-luckfox-bsp/conf/layer.conf
#
# BSP layer for the Luckfox Pico Ultra board family.
# Provides kernel, bootloader and low-level board support for Rockchip RV1106.

BBPATH .= ":${LAYERDIR}"
BBFILES += "${LAYERDIR}/recipes-*/*/*.bb \
             ${LAYERDIR}/recipes-*/*/*.bbappend"

BBFILE_COLLECTIONS += "luckfox-bsp"
BBFILE_PATTERN_luckfox-bsp = "^${LAYERDIR}/"
BBFILE_PRIORITY_luckfox-bsp = "10"

LAYERDEPENDS_luckfox-bsp = "core yocto openembedded-layer"
LAYERSERIES_COMPAT_luckfox-bsp = "scarthgap"
```

## layers/meta-luckfox/conf/distro/luckfox.conf
```bitbake
# Luckfox distro configuration
#
# A lightweight distro based on Poky, trimmed for the RV1106's constrained
# resources (64–128 MB RAM).

require conf/distro/poky.conf

DISTRO = "luckfox"
DISTRO_NAME = "Luckfox Embedded Linux"
DISTRO_VERSION = "1.0"
DISTRO_CODENAME = "pico"

# Remove X11 and OpenGL from default features – this is a headless system
DISTRO_FEATURES:remove = "x11 opengl"

# Use systemd as the init system
DISTRO_FEATURES:append = " systemd usbhost usbgadget"
VIRTUAL-RUNTIME_init_manager = "systemd"
DISTRO_FEATURES_BACKFILL_CONSIDERED:append = " sysvinit"
```

## layers/meta-luckfox/conf/layer.conf
```bitbake
# meta-luckfox/conf/layer.conf
#
# Machine / integration layer for the Luckfox Pico Ultra.
# Depends on meta-luckfox-bsp for low-level board support.

BBPATH .= ":${LAYERDIR}"
BBFILES += "${LAYERDIR}/recipes-*/*/*.bb \
             ${LAYERDIR}/recipes-*/*/*.bbappend"

BBFILE_COLLECTIONS += "luckfox"
BBFILE_PATTERN_luckfox = "^${LAYERDIR}/"
BBFILE_PRIORITY_luckfox = "11"

LAYERDEPENDS_luckfox = "core yocto openembedded-layer luckfox-bsp"
LAYERSERIES_COMPAT_luckfox = "scarthgap"
```

## layers/meta-luckfox/conf/machine/luckfox-pico-ultra.conf
```bitbake
# Machine configuration for the Luckfox Pico Ultra
#
# SoC: Rockchip RV1106
# CPU: ARM Cortex-A7 @ up to 1.2 GHz
# Architecture: ARMv7-A, Thumb-2, NEON, VFPv4, hard-float ABI
# Memory: 64/128 MB DRAM (LPDDR3)
# Storage: internal SPI-NOR / eMMC via Rockchip SDK flash layout
# Connectivity: 100 Mbit Ethernet, WiFi, Bluetooth 5 (BLE)
# Peripherals: I2C, SPI, UART, GPIO, USB OTG, MIPI CSI camera

require conf/machine/include/arm/armv7a/tune-cortexa7.inc

MACHINE_FEATURES = "usbhost usbgadget bluetooth wifi ext4 vfat"

# ---- Kernel ----------------------------------------------------------------
PREFERRED_PROVIDER_virtual/kernel = "linux-luckfox"

KERNEL_IMAGETYPE = "zImage"
KERNEL_DEVICETREE = "rv1106g-luckfox-pico-ultra.dtb"

# Vendor defconfig shipped in the Rockchip BSP kernel tree.
KBUILD_DEFCONFIG = "luckfox_rv1106_linux_defconfig"

# ---- Serial console --------------------------------------------------------
SERIAL_CONSOLES = "1500000;ttyS0"

# ---- Rootfs image format ---------------------------------------------------
IMAGE_FSTYPES = "ext4 tar.bz2"
```
